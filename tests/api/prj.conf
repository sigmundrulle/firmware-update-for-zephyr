## CMakeLists.txt
```
# Ztest: fuz's C API on native_sim, with FFF fakes of the MCUboot functions it calls (run with
# Twister, see docs/contributor/development.md). One file per area of the API, one test suite per
# file.

cmake_minimum_required(VERSION 3.20.0)

find_package(Zephyr REQUIRED HINTS $ENV{ZEPHYR_BASE})
project(fuz_test_api)

target_sources(app PRIVATE
    src/fakes.c
    src/test_api.c
    src/test_confirm.c
    src/test_pending.c
    src/test_revert.c
    src/test_version.c
)

# MCUboot's image format (bootutil/image.h), to write images into the fake slot 1
target_link_libraries(app PRIVATE MCUBOOT_BOOTUTIL)
```

## prj.conf
```kconfig
CONFIG_ZTEST=y
CONFIG_FUZ=y
```

## src/fakes.c
```c
/**
 * @file FFF fakes of the MCUboot and reboot functions fuz calls, defined once for every test file,
 * the calls they got during startup, and the rule that resets them before every test.
 */
#include <setjmp.h>

#include <zephyr/init.h>
#include <zephyr/sys/util.h>
#include <zephyr/toolchain.h>
#include <zephyr/ztest.h>

#include "fakes.h"

DEFINE_FFF_GLOBALS;

DEFINE_FAKE_VALUE_FUNC(bool, boot_is_img_confirmed);
DEFINE_FAKE_VALUE_FUNC(int, boot_write_img_confirmed);
DEFINE_FAKE_VALUE_FUNC(uint8_t, boot_fetch_active_slot);
DEFINE_FAKE_VALUE_FUNC(int, boot_read_bank_header, uint8_t, struct mcuboot_img_header *, size_t);
DEFINE_FAKE_VALUE_FUNC(int, mcuboot_swap_type);
DEFINE_FAKE_VALUE_FUNC(int, flash_area_open, uint8_t, const struct flash_area **);
DEFINE_FAKE_VALUE_FUNC(int, flash_area_read, const struct flash_area *, off_t, void *, size_t);
DEFINE_FAKE_VOID_FUNC(flash_area_close, const struct flash_area *);
DEFINE_FAKE_VOID_FUNC(sys_reboot, int);

jmp_buf sys_reboot_jump;

/* The sys_reboot() fake's body: back to the test's setjmp(), never back to the caller. */
static void sys_reboot_jumps_back(int type)
{
	ARG_UNUSED(type);

	longjmp(sys_reboot_jump, 1);
}

unsigned int startup_is_confirmed_calls;
unsigned int startup_write_calls;

static int save_startup_calls(void)
{
	startup_is_confirmed_calls = boot_is_img_confirmed_fake.call_count;
	startup_write_calls = boot_write_img_confirmed_fake.call_count;

	return 0;
}

/* After fuz's own SYS_INIT: the same level, a later priority. */
BUILD_ASSERT(CONFIG_APPLICATION_INIT_PRIORITY < 99,
	     "save_startup_calls() must run after fuz_confirm_at_boot()");
SYS_INIT(save_startup_calls, APPLICATION, 99);

static void fakes_reset_before(const struct ztest_unit_test *test, void *fixture)
{
	ARG_UNUSED(test);
	ARG_UNUSED(fixture);

	RESET_FAKE(boot_is_img_confirmed);
	RESET_FAKE(boot_write_img_confirmed);
	RESET_FAKE(boot_fetch_active_slot);
	RESET_FAKE(boot_read_bank_header);
	RESET_FAKE(mcuboot_swap_type);
	RESET_FAKE(flash_area_open);
	RESET_FAKE(flash_area_read);
	RESET_FAKE(flash_area_close);
	RESET_FAKE(sys_reboot);
	FFF_RESET_HISTORY();

	sys_reboot_fake.custom_fake = sys_reboot_jumps_back;
}

/* Before every test in every suite, so that no test file can forget it. */
ZTEST_RULE(fakes_reset, fakes_reset_before, NULL);
```

## src/fakes.h
```c
/**
 * @file FFF fakes of the MCUboot, flash map and reboot functions fuz calls: native_sim has no
 * MCUboot, each test chooses what slot 1 holds, and the tests must not restart. They are reset
 * before every test, in every suite, by a ZTEST_RULE in fakes.c, and the calls they got during
 * startup are saved first.
 */
#pragma once

#include <setjmp.h>
#include <stdbool.h>
#include <stddef.h>
#include <stdint.h>

#include <zephyr/dfu/mcuboot.h>
#include <zephyr/fff.h>
#include <zephyr/storage/flash_map.h>

DECLARE_FAKE_VALUE_FUNC(bool, boot_is_img_confirmed);
DECLARE_FAKE_VALUE_FUNC(int, boot_write_img_confirmed);
DECLARE_FAKE_VALUE_FUNC(uint8_t, boot_fetch_active_slot);
DECLARE_FAKE_VALUE_FUNC(int, boot_read_bank_header, uint8_t, struct mcuboot_img_header *, size_t);
DECLARE_FAKE_VALUE_FUNC(int, mcuboot_swap_type);
DECLARE_FAKE_VALUE_FUNC(int, flash_area_open, uint8_t, const struct flash_area **);
DECLARE_FAKE_VALUE_FUNC(int, flash_area_read, const struct flash_area *, off_t, void *, size_t);
DECLARE_FAKE_VOID_FUNC(flash_area_close, const struct flash_area *);
DECLARE_FAKE_VOID_FUNC(sys_reboot, int);

/*
 * Where the sys_reboot() fake jumps back to. sys_reboot() is FUNC_NORETURN, so the code after a
 * call to it may be left out by the compiler, and the fake must not return. Call
 * setjmp(sys_reboot_jump) in the test before anything that may call sys_reboot().
 */
extern jmp_buf sys_reboot_jump;

/*
 * The calls fuz made to each fake during startup (its own SYS_INIT), saved in fakes.c after every
 * SYS_INIT at the APPLICATION level and before the ZTEST_RULE resets the fakes for the first test.
 * At startup, the fakes return their defaults: false and 0.
 */
extern unsigned int startup_is_confirmed_calls;
extern unsigned int startup_write_calls;
```

## src/test_api.c
```c
/**
 * @file Ztest: the module is built into an application, fuz_init() and fuz_is_confirmed() work, and
 * every function not implemented yet links and answers "not supported".
 */
#include <errno.h>

#include <zephyr/sys/util.h>
#include <zephyr/ztest.h>

#include "fakes.h"
#include "fuz/fuz.h"

/* A write function for fuz_init(); nothing is written yet. */
static int write_nothing(const uint8_t *data, size_t len, void *user)
{
	ARG_UNUSED(data);
	ARG_UNUSED(len);
	ARG_UNUSED(user);

	return 0;
}

ZTEST_SUITE(fuz_api, NULL, NULL, NULL, NULL, NULL);

ZTEST(fuz_api, test_module_is_enabled)
{
	/* Fails to build if Zephyr did not find the module: CONFIG_FUZ would not exist. */
	zassert_true(IS_ENABLED(CONFIG_FUZ));
}

/*
 * fuz_init() keeps its state for the whole program, so its three cases run in one test, in
 * order.
 */
ZTEST(fuz_api, test_init)
{
	zassert_equal(fuz_init(NULL, NULL), -EINVAL, "a NULL write function is refused");
	zassert_equal(fuz_init(write_nothing, NULL), 0);
	zassert_equal(fuz_init(write_nothing, NULL), -EALREADY, "only once");
}

ZTEST(fuz_api, test_is_confirmed_asks_mcuboot)
{
	boot_is_img_confirmed_fake.return_val = true;
	zassert_true(fuz_is_confirmed());

	boot_is_img_confirmed_fake.return_val = false;
	zassert_false(fuz_is_confirmed());

	zassert_equal(boot_is_img_confirmed_fake.call_count, 2, "asked MCUboot each time");
}

/*
 * Every function not implemented yet links and says so. Remove a line when its function is
 * implemented, and give that function a test of its own.
 */
ZTEST(fuz_api, test_stubs)
{
	const uint8_t frame[] = {0x06, 0x09};

	zassert_equal(fuz_receive_smp_frame(frame, sizeof(frame)), -ENOTSUP);

	zassert_false(fuz_is_restart_requested());

	zassert_equal(fuz_set_ready_for_restart(), -ENOENT);
}
```

## src/test_confirm.c
```c
/**
 * @file Ztest: fuz_confirm() and the confirm at startup in each confirm mode (the variants in
 * testcase.yaml).
 */
#include <errno.h>

#include <zephyr/sys/util.h>
#include <zephyr/ztest.h>

#include "fakes.h"
#include "fuz/fuz.h"

ZTEST_SUITE(fuz_confirm, NULL, NULL, NULL, NULL, NULL);

ZTEST(fuz_confirm, test_by_client_refuses)
{
	Z_TEST_SKIP_IFNDEF(CONFIG_FUZ_CONFIRM_BY_CLIENT);

	/* Even when the client has confirmed already: the answer does not depend on timing. */
	boot_is_img_confirmed_fake.return_val = true;

	zassert_equal(fuz_confirm(), -EPERM, "only the client may confirm");
	zassert_equal(boot_write_img_confirmed_fake.call_count, 0, "nothing written");
}

ZTEST(fuz_confirm, test_writes)
{
	Z_TEST_SKIP_IFDEF(CONFIG_FUZ_CONFIRM_BY_CLIENT);

	boot_is_img_confirmed_fake.return_val = false;
	boot_write_img_confirmed_fake.return_val = 0;

	zassert_equal(fuz_confirm(), 0);
	zassert_equal(boot_write_img_confirmed_fake.call_count, 1, "written once");
}

ZTEST(fuz_confirm, test_already_confirmed)
{
	Z_TEST_SKIP_IFDEF(CONFIG_FUZ_CONFIRM_BY_CLIENT);

	boot_is_img_confirmed_fake.return_val = true;

	zassert_equal(fuz_confirm(), -EALREADY);
	zassert_equal(boot_write_img_confirmed_fake.call_count, 0, "nothing written");
}

ZTEST(fuz_confirm, test_passes_on_write_error)
{
	Z_TEST_SKIP_IFDEF(CONFIG_FUZ_CONFIRM_BY_CLIENT);

	boot_is_img_confirmed_fake.return_val = false;
	boot_write_img_confirmed_fake.return_val = -EIO;

	zassert_equal(fuz_confirm(), -EIO, "MCUboot's error, unchanged");
}

ZTEST(fuz_confirm, test_at_boot_confirms_at_startup)
{
	Z_TEST_SKIP_IFNDEF(CONFIG_FUZ_CONFIRM_AT_BOOT);

	/* At startup, the fakes answer "not confirmed" (false), so fuz confirms. */
	zassert_equal(startup_is_confirmed_calls, 1);
	zassert_equal(startup_write_calls, 1);
}

ZTEST(fuz_confirm, test_other_modes_do_not_confirm_at_startup)
{
	Z_TEST_SKIP_IFDEF(CONFIG_FUZ_CONFIRM_AT_BOOT);

	/* With a time limit, fuz asks at startup whether to start it (tests/confirm_timeout). */
#if defined(CONFIG_FUZ_CONFIRM_TIMEOUT_MS) && (CONFIG_FUZ_CONFIRM_TIMEOUT_MS > 0)
	zassert_equal(startup_is_confirmed_calls, 1);
#else
	zassert_equal(startup_is_confirmed_calls, 0);
#endif
	zassert_equal(startup_write_calls, 0);
}
```

## src/test_pending.c
```c
/**
 * @file Ztest: fuz_is_secondary_pending() for each swap type MCUboot can report.
 */
#include <errno.h>

#include <zephyr/dfu/mcuboot.h>
#include <zephyr/ztest.h>

#include "fakes.h"
#include "fuz/fuz.h"

/* MCUboot's BOOT_SWAP_TYPE_PANIC (bootutil_public.h): a trailer could not be read. */
#define SWAP_TYPE_PANIC 0xff

ZTEST_SUITE(fuz_pending, NULL, NULL, NULL, NULL, NULL);

ZTEST(fuz_pending, test_test_is_pending)
{
	mcuboot_swap_type_fake.return_val = BOOT_SWAP_TYPE_TEST;

	zassert_equal(fuz_is_secondary_pending(), 1, "marked with image test");
}

ZTEST(fuz_pending, test_perm_is_pending)
{
	mcuboot_swap_type_fake.return_val = BOOT_SWAP_TYPE_PERM;

	zassert_equal(fuz_is_secondary_pending(), 1, "marked with image confirm");
}

ZTEST(fuz_pending, test_none_is_not_pending)
{
	mcuboot_swap_type_fake.return_val = BOOT_SWAP_TYPE_NONE;

	zassert_equal(fuz_is_secondary_pending(), 0);
}

ZTEST(fuz_pending, test_revert_is_not_pending)
{
	mcuboot_swap_type_fake.return_val = BOOT_SWAP_TYPE_REVERT;

	zassert_equal(fuz_is_secondary_pending(), 0, "the previous image comes back, nothing new");
}

ZTEST(fuz_pending, test_panic_is_an_error)
{
	mcuboot_swap_type_fake.return_val = SWAP_TYPE_PANIC;

	zassert_equal(fuz_is_secondary_pending(), -EIO, "a positive 0xff, not a pending swap");
}

ZTEST(fuz_pending, test_unknown_swap_type_is_an_error)
{
	mcuboot_swap_type_fake.return_val = BOOT_SWAP_TYPE_FAIL;

	zassert_equal(fuz_is_secondary_pending(), -EIO);
}
```

## src/test_revert.c
```c
/**
 * @file Ztest: fuz_revert() in each confirm mode (the variants in testcase.yaml); it is allowed in
 * every mode.
 */
#include <errno.h>
#include <setjmp.h>

#include <zephyr/sys/reboot.h>
#include <zephyr/ztest.h>

#include "fakes.h"
#include "fuz/fuz.h"

ZTEST_SUITE(fuz_revert, NULL, NULL, NULL, NULL, NULL);

ZTEST(fuz_revert, test_restarts_without_confirming)
{
	boot_is_img_confirmed_fake.return_val = false;

	/* The sys_reboot() fake jumps back here, with setjmp() returning 1. */
	if (setjmp(sys_reboot_jump) == 0) {
		(void)fuz_revert();
		zassert_unreachable("fuz_revert() returned instead of restarting");
	}

	zassert_equal(sys_reboot_fake.call_count, 1, "restarted once");
	zassert_equal(sys_reboot_fake.arg0_val, SYS_REBOOT_WARM);
	zassert_equal(boot_write_img_confirmed_fake.call_count, 0, "nothing written");
}

ZTEST(fuz_revert, test_already_confirmed)
{
	boot_is_img_confirmed_fake.return_val = true;

	zassert_equal(fuz_revert(), -EALREADY);
	zassert_equal(sys_reboot_fake.call_count, 0, "no restart");
}
```

## src/test_version.c
```c
/**
 * @file Ztest: reading the image versions from MCUboot's image headers.
 */
#include <errno.h>
#include <stddef.h>
#include <stdint.h>
#include <string.h>

#include <zephyr/dfu/mcuboot.h>
#include <zephyr/storage/flash_map.h>
#include <zephyr/sys/byteorder.h>
#include <zephyr/sys/util.h>
#include <zephyr/ztest.h>

#include <bootutil/image.h>

#include "fakes.h"
#include "fuz/fuz.h"

/* The flash area the boot_fetch_active_slot() fake answers, passed on to the header read. */
#define ACTIVE_SLOT 3U

/* The boot_read_bank_header() fake's body: a v1 header with version 2.1.3+4. */
static int read_header_v2_1_3_4(uint8_t area_id, struct mcuboot_img_header *header,
				size_t header_size)
{
	ARG_UNUSED(area_id);
	ARG_UNUSED(header_size);

	header->mcuboot_version = 1U;
	header->h.v1.image_size = 1024U;
	header->h.v1.sem_ver.major = 2U;
	header->h.v1.sem_ver.minor = 1U;
	header->h.v1.sem_ver.revision = 3U;
	header->h.v1.sem_ver.build_num = 4U;

	return 0;
}

ZTEST_SUITE(fuz_version, NULL, NULL, NULL, NULL, NULL);

ZTEST(fuz_version, test_running_version_refuses_null)
{
	zassert_equal(fuz_get_running_version(NULL), -EINVAL);
	zassert_equal(boot_read_bank_header_fake.call_count, 0, "nothing read");
}

ZTEST(fuz_version, test_running_version_reads_the_active_slot)
{
	struct mcuboot_img_sem_ver version = {0};

	boot_fetch_active_slot_fake.return_val = ACTIVE_SLOT;
	boot_read_bank_header_fake.custom_fake = read_header_v2_1_3_4;

	zassert_equal(fuz_get_running_version(&version), 0);
	zassert_equal(boot_read_bank_header_fake.call_count, 1, "read once");
	zassert_equal(boot_read_bank_header_fake.arg0_val, ACTIVE_SLOT, "from the active slot");
	zassert_equal(boot_read_bank_header_fake.arg2_val, sizeof(struct mcuboot_img_header));

	zassert_equal(version.major, 2);
	zassert_equal(version.minor, 1);
	zassert_equal(version.revision, 3);
	zassert_equal(version.build_num, 4);
}

ZTEST(fuz_version, test_running_version_passes_on_read_error)
{
	struct mcuboot_img_sem_ver version = {.major = 7};

	boot_read_bank_header_fake.return_val = -EIO;

	zassert_equal(fuz_get_running_version(&version), -EIO, "MCUboot's error, unchanged");
	zassert_equal(version.major, 7, "version left unchanged on failure");
}

/* Slot 1 as the flash map fakes give it: a buffer, erased (0xff) before every slot 1 test. */
#define SLOT1_SIZE 1024U
static uint8_t slot1[SLOT1_SIZE];
static const struct flash_area slot1_area = {.fa_size = SLOT1_SIZE};

/* An image as the tests write it: a header, CODE_SIZE bytes of code, then TLVs. */
#define CODE_SIZE 100U

static int open_slot1(uint8_t id, const struct flash_area **fa)
{
	ARG_UNUSED(id);

	*fa = &slot1_area;
	return 0;
}

static int read_slot1(const struct flash_area *fa, off_t off, void *dst, size_t len)
{
	ARG_UNUSED(fa);

	if (off < 0 || (size_t)off + len > SLOT1_SIZE) {
		return -EINVAL;
	}

	memcpy(dst, &slot1[off], len);
	return 0;
}

/* Write a header at off with version 2.1.3+4 and CODE_SIZE bytes of code; return the TLV offset. */
static size_t put_header(size_t off)
{
	sys_put_le32(IMAGE_MAGIC, &slot1[off]);
	sys_put_le16(IMAGE_HEADER_SIZE, &slot1[off + 8]);
	sys_put_le32(CODE_SIZE, &slot1[off + 12]);
	slot1[off + 20] = 2U;
	slot1[off + 21] = 1U;
	sys_put_le16(3U, &slot1[off + 22]);
	sys_put_le32(4U, &slot1[off + 24]);
	memset(&slot1[off + IMAGE_HEADER_SIZE], 0, CODE_SIZE);

	return off + IMAGE_HEADER_SIZE + CODE_SIZE;
}

/* Write a TLV area at off with the given number of SHA-256 TLVs; return the offset after it. */
static size_t put_tlvs(size_t off, uint16_t magic, int hashes)
{
	size_t tot = 4U + (size_t)hashes * (4U + 32U);

	sys_put_le16(magic, &slot1[off]);
	sys_put_le16((uint16_t)tot, &slot1[off + 2]);
	for (int i = 0; i < hashes; i++) {
		size_t tlv = off + 4U + (size_t)i * (4U + 32U);

		sys_put_le16(IMAGE_TLV_SHA256, &slot1[tlv]);
		sys_put_le16(32U, &slot1[tlv + 2]);
		memset(&slot1[tlv + 4], 0xab, 32);
	}

	return off + tot;
}

static void slot1_before(void *fixture)
{
	ARG_UNUSED(fixture);

	memset(slot1, 0xff, sizeof(slot1));
	flash_area_open_fake.custom_fake = open_slot1;
	flash_area_read_fake.custom_fake = read_slot1;
}

ZTEST_SUITE(fuz_secondary_version, NULL, NULL, slot1_before, NULL, NULL);

ZTEST(fuz_secondary_version, test_refuses_null)
{
	zassert_equal(fuz_get_secondary_version(NULL), -EINVAL);
	zassert_equal(flash_area_open_fake.call_count, 0, "nothing opened");
}

ZTEST(fuz_secondary_version, test_reads_a_complete_image)
{
	struct mcuboot_img_sem_ver version = {0};

	put_tlvs(put_header(0), IMAGE_TLV_INFO_MAGIC, 1);

	zassert_equal(fuz_get_secondary_version(&version), 0);
	zassert_equal(flash_area_open_fake.arg0_val, PARTITION_ID(slot1_partition), "slot 1");
	zassert_equal(flash_area_close_fake.call_count, 1, "closed again");

	zassert_equal(version.major, 2);
	zassert_equal(version.minor, 1);
	zassert_equal(version.revision, 3);
	zassert_equal(version.build_num, 4);
}

ZTEST(fuz_secondary_version, test_reads_past_a_protected_tlv_area)
{
	struct mcuboot_img_sem_ver version = {0};

	put_tlvs(put_tlvs(put_header(0), IMAGE_TLV_PROT_INFO_MAGIC, 0), IMAGE_TLV_INFO_MAGIC, 1);

	zassert_equal(fuz_get_secondary_version(&version), 0);
	zassert_equal(version.major, 2);
}

ZTEST(fuz_secondary_version, test_erased_slot_holds_no_image)
{
	struct mcuboot_img_sem_ver version = {.major = 7};

	zassert_equal(fuz_get_secondary_version(&version), -ENOENT);
	zassert_equal(version.major, 7, "version left unchanged on failure");
	zassert_equal(flash_area_close_fake.call_count, 1, "closed again");
}

ZTEST(fuz_secondary_version, test_unfinished_upload_holds_no_image)
{
	struct mcuboot_img_sem_ver version = {.major = 7};

	/* The header and code are written, the TLVs (last in an upload) are still erased. */
	put_header(0);

	zassert_equal(fuz_get_secondary_version(&version), -ENOENT);
	zassert_equal(version.major, 7, "version left unchanged on failure");
}

ZTEST(fuz_secondary_version, test_image_without_a_hash_is_not_valid)
{
	struct mcuboot_img_sem_ver version = {.major = 7};

	put_tlvs(put_header(0), IMAGE_TLV_INFO_MAGIC, 0);

	zassert_equal(fuz_get_secondary_version(&version), -ENOENT);
}

ZTEST(fuz_secondary_version, test_image_with_two_hashes_is_not_valid)
{
	struct mcuboot_img_sem_ver version = {.major = 7};

	put_tlvs(put_header(0), IMAGE_TLV_INFO_MAGIC, 2);

	zassert_equal(fuz_get_secondary_version(&version), -ENOENT);
}

ZTEST(fuz_secondary_version, test_passes_on_a_read_error)
{
	struct mcuboot_img_sem_ver version = {.major = 7};

	flash_area_read_fake.custom_fake = NULL;
	flash_area_read_fake.return_val = -EIO;

	zassert_equal(fuz_get_secondary_version(&version), -EIO, "the flash error, unchanged");
	zassert_equal(version.major, 7, "version left unchanged on failure");
	zassert_equal(flash_area_close_fake.call_count, 1, "closed again");
}

ZTEST(fuz_secondary_version, test_passes_on_an_open_error)
{
	struct mcuboot_img_sem_ver version = {.major = 7};

	flash_area_open_fake.custom_fake = NULL;
	flash_area_open_fake.return_val = -ENODEV;

	zassert_equal(fuz_get_secondary_version(&version), -ENODEV);
	zassert_equal(flash_area_close_fake.call_count, 0, "nothing to close");
}
```
