## Kconfig
```kconfig
menuconfig FUZ
	bool "Firmware update for Zephyr (fuz): over SMP (mcumgr) through MCUboot"
	depends on BOOTLOADER_MCUBOOT || ZTEST
	depends on !MCUBOOT_BOOTLOADER_MODE_RAM_LOAD
	select FLASH if BOOTLOADER_MCUBOOT
	select FLASH_MAP if BOOTLOADER_MCUBOOT
	select STREAM_FLASH if BOOTLOADER_MCUBOOT
	select IMG_MANAGER if BOOTLOADER_MCUBOOT
	select REBOOT if BOOTLOADER_MCUBOOT
	help
	  Receive a new image on the application's serial port over SMP, test-run it through
	  MCUboot, and confirm or revert it. The application passes SMP frames to the module and
	  reports its self-test result; see include/fuz/fuz.h.

	  Needs an application built with MCUboot (west build --sysbuild). MCUboot's RAM load
	  mode is not supported: it has no test run, confirm or revert.

# The client must not confirm the image in slot 1 before it has run (docs/decisions.md, Who confirms
# a new image). Zephyr defaults this to y in every swap mode; modules are read before Zephyr's
# subsys/, so this default wins. src/fuz.c stops the build if a product sets it to y.
configdefault MCUMGR_GRP_IMG_ALLOW_CONFIRM_NON_ACTIVE_SLOT
	default n if FUZ

if FUZ

choice FUZ_CONFIRM
	prompt "Who confirms a new image"
	default FUZ_CONFIRM_BY_PRODUCT
	help
	  After an update, MCUboot runs the new image as a test. Unless the image is
	  confirmed, MCUboot goes back to the previous image at the next restart. This
	  chooses who confirms it.

	  In the modes where the client confirms, MCUboot goes back if the client does not
	  return: when CONFIG_FUZ_CONFIRM_TIMEOUT_MS has passed, or at the next restart if
	  there is no time limit. The client rejects an image by restarting without
	  confirming it, or with SMP image test on the previous image. SMP has no command
	  to reject an image.

	  The choice is made when the image is built, so the new image's setting applies
	  while it is being tested.

config FUZ_CONFIRM_AT_BOOT
	bool "fuz, at startup"
	help
	  fuz confirms the running image when it starts, so an update is never reverted.
	  For products without a self-test. fuz_confirm() and fuz_revert() return
	  -EALREADY.

config FUZ_CONFIRM_BY_PRODUCT
	bool "Only the product"
	help
	  The product confirms with fuz_confirm() when its self-test has passed. The
	  client's image state writes (SMP image test and image confirm) are rejected
	  until the running image is confirmed, so the client cannot skip the self-test.

config FUZ_CONFIRM_BY_CLIENT
	bool "Only the client"
	help
	  The client confirms with SMP image confirm, and fuz_confirm() returns -EPERM.
	  The product can still reject the image with fuz_revert().

config FUZ_CONFIRM_BY_ANY
	bool "The product or the client"
	help
	  Whichever comes first: the product with fuz_confirm() or the client with SMP
	  image confirm. This is how Zephyr behaves without fuz.

endchoice

config FUZ_CONFIRM_TIMEOUT_MS
	int "Time limit for confirming a new image (ms)"
	default 0
	range 0 2147483647
	depends on !FUZ_CONFIRM_AT_BOOT
	help
	  If the running image is not confirmed within this time after startup, fuz
	  restarts without confirming it, and MCUboot goes back to the previous image.
	  The restart comes at once, without asking the product to shut down first.
	  Must be longer than the product's self-test.

	  0 means no time limit: the image runs until the next restart. With
	  CONFIG_FUZ_CONFIRM_BY_PRODUCT, the product cannot be updated until then, since
	  image state writes are rejected.

config FUZ_RESET_READY_TIMEOUT_MS
	int "Time limit for the product to get ready for a restart (ms)"
	default 1500
	range 1 2147483647
	help
	  After the client's SMP os reset, the product has this long to call
	  fuz_set_ready_for_restart(). If it does not, fuz answers the client with busy
	  and does not restart.

	  Keep it shorter than the client's own timeout, or the client gives up before
	  the busy answer arrives: smpmgr waits 2 s by default (--timeout).

module = FUZ
module-str = fuz
source "subsys/logging/Kconfig.template.log_config"

# Zephyr's log template gives the menu no help; this adds it to the same choice.
choice FUZ_LOG_LEVEL_CHOICE
	help
	  The most detailed fuz log messages built into the image; more detailed ones
	  are left out and cost no flash. Default follows Zephyr's LOG_DEFAULT_LEVEL,
	  which is 3 (Info) unless the product sets it: errors, warnings and info are
	  built in, debug is not. Choose a level here to set fuz alone, for example
	  Debug (CONFIG_FUZ_LOG_LEVEL_DBG=y in prj.conf).
endchoice

endif # FUZ
```

## tests/confirm_timeout/testcase.yaml
```yaml
common:
  platform_allow:
    - native_sim
  integration_platforms:
    - native_sim
tests:
  # Default Kconfig: CONFIG_TEST_CASE_EXPIRES, CONFIG_FUZ_CONFIRM_BY_PRODUCT, a 200 ms limit.
  fuz.confirm_timeout.expires: {}
  fuz.confirm_timeout.product_confirms:
    extra_configs:
      - CONFIG_TEST_CASE_PRODUCT_CONFIRMS=y
  fuz.confirm_timeout.client_confirms:
    extra_configs:
      - CONFIG_TEST_CASE_CLIENT_CONFIRMS=y
      - CONFIG_FUZ_CONFIRM_BY_CLIENT=y
  fuz.confirm_timeout.confirmed_at_startup:
    extra_configs:
      - CONFIG_TEST_CASE_CONFIRMED_AT_STARTUP=y
  fuz.confirm_timeout.no_limit:
    extra_configs:
      - CONFIG_TEST_CASE_NO_LIMIT=y
      - CONFIG_FUZ_CONFIRM_TIMEOUT_MS=0
```

## tests/smoke/testcase.yaml
```yaml
common:
  platform_allow:
    - native_sim
  integration_platforms:
    - native_sim
tests:
  # Default Kconfig: CONFIG_FUZ_CONFIRM_BY_PRODUCT.
  fuz.smoke: {}
  # The other confirm modes and the time limits, so that each one is checked against Kconfig.
  fuz.smoke.confirm_at_boot:
    extra_configs:
      - CONFIG_FUZ_CONFIRM_AT_BOOT=y
  fuz.smoke.confirm_by_client:
    extra_configs:
      - CONFIG_FUZ_CONFIRM_BY_CLIENT=y
  fuz.smoke.confirm_by_any:
    extra_configs:
      - CONFIG_FUZ_CONFIRM_BY_ANY=y
  fuz.smoke.time_limits:
    extra_configs:
      - CONFIG_FUZ_CONFIRM_TIMEOUT_MS=60000
      - CONFIG_FUZ_RESET_READY_TIMEOUT_MS=1000
```
